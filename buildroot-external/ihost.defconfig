## buildroot-external/ihost.defconfig
```kconfig
CONFIG_ARM_PSCI=y
CONFIG_HIGHMEM=y
CONFIG_ARCH_ROCKCHIP=y
CONFIG_ROCKCHIP_PHY=y
CONFIG_MMC_DW_ROCKCHIP=y
CONFIG_PL330_DMA=y
CONFIG_ROCKCHIP_IOMMU=y
CONFIG_ROCKCHIP_IODOMAIN=y
CONFIG_ROCKCHIP_PM_DOMAINS=y
CONFIG_TEE=y
CONFIG_OPTEE=y
CONFIG_INPUT_RK805_PWRKEY=y
CONFIG_I2C_RK3X=y
CONFIG_MFD_RK8XX_I2C=y #6.5+
CONFIG_RTC_DRV_PCF8563=y
CONFIG_COMMON_CLK_RK808=y
CONFIG_PINCTRL_RK805=y
CONFIG_REGULATOR_RK808=y
CONFIG_BT_HCIUART=y
CONFIG_BT_HCIUART_H4=y
CONFIG_BT_HCIUART_RTL=y

CONFIG_RTW88=m
CONFIG_RTW88_8723DS=m

CONFIG_PHY_ROCKCHIP_NANENG_USB2=y
```

## buildroot-external/package/odroid-dtbo/Config.in
```kconfig
config BR2_PACKAGE_ODROID_DTBO
	bool "odroid dtbo overlays"
	depends on BR2_LINUX_KERNEL
	help
	  Install overlays for Odroid M1s
```
